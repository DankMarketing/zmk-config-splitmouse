## config/west.yml
```yaml
manifest:
  remotes:
    - name: zmkfirmware
      url-base: https://github.com/zmkfirmware
    - name: jgreel
      url-base: https://github.com/jgreel
  projects:
    - name: zmk
      remote: jgreel
      revision: mouse-ftc-cirque
      import: app/west.yml
  self:
    path: config
```
